## app/boards/arm/nrf52840_dongle/Kconfig.board
```kconfig
# Maker Diary nrf52840 M.2 board configuration

# Copyright (c) 2020 The ZMK Contributors
# SPDX-License-Identifier: MIT

config BOARD_NRF52840_DONGLE
	bool "nrf52480_dongle"
	depends on SOC_NRF52840_QIAA
```

## app/boards/arm/nrf52840_dongle/Kconfig.defconfig
```kconfig
# Copyright (c) 2020 The ZMK Contributors
# SPDX-License-Identifier: MIT

if BOARD_NRF52840_DONGLE

config BOARD
	default "nrf52480_dongle"

if USB_DEVICE_STACK

config USB_NRFX
	default y

endif # USB_DEVICE_STACK

config BT_CTLR
	default BT

config ZMK_BLE
	default y

config ZMK_USB
	default y

endif # BOARD_NRF52840_DONGLE
```

## app/boards/shields/wireless_ergodox/Kconfig.defconfig
```kconfig
if SHIELD_WIRELESS_ERGODOX_DONGLE

config ZMK_KEYBOARD_NAME
    default "WirelessErgodox"

config ZMK_SPLIT_ROLE_CENTRAL
    default y

endif

if SHIELD_WIRELESS_ERGODOX_DONGLE || SHIELD_WIRELESS_ERGODOX_LEFT || SHIELD_WIRELESS_ERGODOX_RIGHT

config ZMK_SPLIT
    default y

config BT
    default y

config USB_DEVICE_STACK
    default y

endif
```

## app/boards/shields/wireless_ergodox/Kconfig.shield
```kconfig
config SHIELD_WIRELESS_ERGODOX_DONGLE
    def_bool $(shields_list_contains,wireless_ergodox_dongle)

config SHIELD_WIRELESS_ERGODOX_LEFT
    def_bool $(shields_list_contains,wireless_ergodox_left)

config SHIELD_WIRELESS_ERGODOX_RIGHT
    def_bool $(shields_list_contains,wireless_ergodox_right)
```
